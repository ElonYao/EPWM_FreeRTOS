/**
 * @cliArgs --board "/boards/LAUNCHXL_F280039C" --device "F28003x" --part "F28003x_100PZ" --package "100PZ" --context "system" --product "C2000WARE@5.05.00.00"
 * @versions {"tool":"1.24.0+4150"}
 */

/**
 * Import the modules used in this configuration.
 */
const epwm      = scripting.addModule("/driverlib/epwm.js", {}, false);
const epwm1     = epwm.addInstance();
const sci       = scripting.addModule("/driverlib/sci.js", {}, false);
const sci1      = sci.addInstance();
const FREERTOS  = scripting.addModule("/kernel/freertos_tool/FREERTOS", {}, false);
const FREERTOS1 = FREERTOS.addInstance();

/**
 * Write custom configuration values to the imported modules.
 */
epwm1.epwmTimebase_hsClockDiv                                    = "EPWM_HSCLOCK_DIVIDER_1";
epwm1.epwmTimebase_counterMode                                   = "EPWM_COUNTER_MODE_UP_DOWN";
epwm1.epwmTimebase_period                                        = 6000;
epwm1.epwmTimebase_periodLoadMode                                = "EPWM_PERIOD_DIRECT_LOAD";
epwm1.epwmTimebase_counterModeAfterSync                          = "EPWM_COUNT_MODE_UP_AFTER_SYNC";
epwm1.epwmTimebase_syncInPulseSource                             = "EPWM_SYNC_IN_PULSE_SRC_DISABLE";
epwm1.epwmActionQualifier_EPWM_AQ_OUTPUT_A_shadowMode            = true;
epwm1.epwmActionQualifier_EPWM_AQ_OUTPUT_A_ON_TIMEBASE_UP_CMPA   = "EPWM_AQ_OUTPUT_HIGH";
epwm1.epwmActionQualifier_EPWM_AQ_OUTPUT_A_ON_TIMEBASE_DOWN_CMPA = "EPWM_AQ_OUTPUT_LOW";
epwm1.epwmActionQualifier_EPWM_AQ_OUTPUT_B_shadowMode            = true;
epwm1.epwmDeadband_delayRED                                      = 50;
epwm1.epwmDeadband_enableFED                                     = true;
epwm1.epwmDeadband_delayFED                                      = 50;
epwm1.epwmCounterCompare_cmpA                                    = 10;
epwm1.epwmCounterCompare_cmpB                                    = 10;
epwm1.$name                                                      = "PWM1";
epwm1.$hardware                                                  = system.deviceData.board.components.BP_SITE_1.subComponents.PWM_LOC1;
epwm1.epwmDeadband_enableRED                                     = true;
epwm1.epwmDeadband_polarityFED                                   = "EPWM_DB_POLARITY_ACTIVE_LOW";

sci1.$name                 = "UART";
sci1.$hardware             = system.deviceData.board.components.XDS_UART.subComponents.XDS_SCI_INST2;
sci1.enabledFIFOInterrupts = ["SCI_INT_RXFF"];
sci1.rxFifo                = "SCI_FIFO_RX2";
sci1.rxQual.$name          = "myGPIOQUAL0";
sci1.txQual.$name          = "myGPIOQUAL1";

FREERTOS1.$name                         = "RTOS0";
FREERTOS1.START_SCHEDULER               = false;
FREERTOS1.CPU_CLOCK_HZ                  = 120000000;
FREERTOS1.MAX_PRIORITIES                = 5;
FREERTOS1.MINIMAL_STACK_SIZE            = 256;
FREERTOS1.IDLE_SHOULD_YIELD             = true;
FREERTOS1.USE_MUTEXES                   = true;
FREERTOS1.USE_COUNTING_SEMAPHORES       = true;
FREERTOS1.USE_QUEUE_SETS                = true;
FREERTOS1.ENABLE_BACKWARD_COMPATIBILITY = true;
FREERTOS1.TOTAL_HEAP_SIZE               = 2048;
FREERTOS1.CHECK_FOR_STACK_OVERFLOW      = 2;
FREERTOS1.USE_MALLOC_FAILED_HOOK        = true;
FREERTOS1.vTaskDelete                   = true;

/**
 * Pinmux solution for unlocked pins/peripherals. This ensures that minor changes to the automatic solver in a future
 * version of the tool will not impact the pinmux you originally saw.  These lines can be completely deleted in order to
 * re-solve from scratch.
 */
epwm1.epwm.$suggestSolution           = "EPWM1";
epwm1.epwm.epwm_aPin.$suggestSolution = "boosterpack1.40";
epwm1.epwm.epwm_bPin.$suggestSolution = "boosterpack1.39";
sci1.sci.$suggestSolution             = "SCIB";
sci1.sci.sci_rxPin.$suggestSolution   = "boosterpack2.43";
sci1.sci.sci_txPin.$suggestSolution   = "boosterpack2.44";
